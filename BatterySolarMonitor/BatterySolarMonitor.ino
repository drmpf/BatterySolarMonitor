// BatterySolarMonitor 
// Board: FireBeetle 2 ESP32-E  4M version choose flash size 4M in tools and choose compiled with Huge APP 3M flash / 1M SPIFFS
// with ESP32 board support V3.3.11
// Connection: http
// set static IP 192.168.1.122 (example)
// needs pfodParser library V5.1.12+


/**
 As well as Battery Solar Charge control, 
 this sketch check if the Main AC is still available.
 If not it sounds a buzzer.
 The push button cancels the buzzer after which the buzzer will not sound again until the Mains is restored and is then lost again
 Restoring mains power also cancels the buzzer.
*/

/* Code generated by pfodWeb V4.1.10-- 10th Sept 2026
 * (c)2026 Forward Computing and Control Pty. Ltd.
 * NSW Australia, www.forward.com.au
 * This code is not warranted to be fit for any purpose. You may only use it at your own risk.
 * This generated code may be freely used for both private and commercial use
 * provided this copyright is maintained.
 */
/**


 If useLittleFSToServe_pfodWeb is set to true (default false) then the pfodWeb files need to be uploaded to the micro's file system
 The data upload for ESP8266, Pi Pico and ESP32, uses https://github.com/earlephilhower/arduino-littlefs-upload V0.2.0 installed in Arduino IDE V2
 https://github.com/earlephilhower/arduino-pico-littlefs-plugin/releases
 
 This project starts a web server (port 80) to be connected to by pfodWeb.html
 See the tutorial at https://www.forward.com.au/pfod/pfodWeb/index.html

 Setup Notes:
 WiFi network SSID/password/(optional) static IP are NOT hardcoded in this
 sketch -- they are set up via the ESPAutoWiFiConfig library's own
 self-hosted config web page (see the "WiFi settings" section of the code
 below, and ESPAutoWiFiConfig/ESPAutoWiFiConfigAI-guide.md for the full
 flow). Before running this code:
  a) Upload the sketch.
  b) Watch the onboard RGB LED: it flashes FAST once the device has no
     stored WiFi network yet -- it is now its own WiFi Access Point.
  c) Connect your phone/laptop to WiFi network "WiFiConfig" (password
     "12345678"), then browse to http://192.168.1.1 (or just open any
     website -- you'll be redirected there automatically).
  d) Fill in your real network's SSID/password, and (optionally) a static
     IP on your network -- leave the static IP field blank to use DHCP and
     find the assigned IP from the Serial Monitor instead (see below).
     NOTE: if you do set a static IP, this device's own gateway is always
     assumed to be that IP's subnet with the last octet forced to .1 --
     see the AI guide's 6 if the device fails to connect afterwards.
  e) Submit -- the device saves the settings and auto-restarts, this time
     connecting to your real network.
  f) Reconnect your own phone/laptop to your normal WiFi (you were on the
     device's own "WiFiConfig" AP for steps c/d).
  g) From the pfodParse library, in sub-directory pfodWeb, open pfodWeb.html in any web browser
     and selecte HTTP connection, fill in the IP for this board, click Connect to display GUI

  To reconfigure the network later (e.g. moved to a new router): power-cycle
  the device twice within 10 seconds -- that forces it back into the AP
  config mode of step (b) above on the next boot.

  // To serve pfodWeb from the micro's file system
  =================================================
  If useLittleFSToServe_pfodWeb (below) is set to true then
  this code can also serve the pfodWeb files directly from the micro's file system.
  The files are in the data sub-directory of this sketch.
  This needs 1MB of file system space on the microprocessor.

  a) Configure the Tool menu Flash Size: to have FS (LittleFS file system) of 1MB for ESP32, Pi PicoW/2W and ESP8266
  b) Complete the WiFi setup above (SSID/password/optional static IP)
  c) Edit **useLittleFSToServe_pfodWeb** to true to start the FS file system
  d) Do an initial upload of the sketch,
  e) CLOSE  the serial monitor.
  f) Use Ctrl+Shift+P  and search for "Upload LittleFS to Pico/ESP8266/ESP32" and upload the support files from the data sub-directory

  Check the Serial Monitor for the board's IP address e.g.
 Connected! IP address: 192.168.1.100
  Then in a web browser type  http://192.168.1.100  Note carefully use http:// NOT https://  to display the index.html page
*/

static bool useLittleFSToServe_pfodWeb = true; // do no start LittleFS, need to use pfodWeb.html on computer to display drawing
// cacheSec only used if useLittleFSToServe_pfodWeb = true;
static uint32_t cacheSec = 10*60;  //seconds = 10mins, if useLittleFSToServe_pfodWeb = true use this to control cache timeout

// =================== WiFi settings ===================
// SSID/password/(optional) static IP are set up at runtime via
// ESPAutoWiFiConfig's own self-hosted config web page -- see the top-of-
// file comment above and ESPAutoWiFiConfig/ESPAutoWiFiConfigAI-guide.md.
// Only the LED that shows connect/AP-config status is a hardware choice
// fixed here.
int wifiConfigLedPin = -5;           // DFRobot FireBeetle 2 ESP32-E's onboard RGB LED is a WS2812 on GPIO5 -- negative pin value => drive it as a WS2812, not a plain GPIO (see ESPAutoWiFiConfigAI-guide.md)
bool wifiConfigHighForLedOn = true;  // normal WS2812 polarity -- LED off once WiFi connects, fast-flashes while in AP config mode
const char wifiConfigDeviceName[] = "BatterySolarMonitor";  // shown on the WiFi-config web page only, cosmetic

// =================== Car charger / hot water auto-control ===================
// Master safety switch for LoadControlTask.cpp's SOC-hysteresis auto-control
// (ported from dailyPrediction/plot_today_solar.py's control_loads()).
// Defaults to false: as of this port landing, plot_today_solar.py is STILL
// the live controller for both the car charger and hot water element --
// it was given its own ENABLE_LOAD_CONTROL switch (dailyPrediction/
// plot_today_solar.py, near SOC_CONTROL_START) specifically so it could be
// handed off. Running BOTH controllers against the same physical hardware
// at once would have them fighting each other (different poll phase,
// possibly different momentary SOC reading, each believing it owns a load
// the other just changed).
// BEFORE setting this to true: set plot_today_solar.py's own
// ENABLE_LOAD_CONTROL to False first, so exactly one controller is ever
// live. See the plan in memory (project_car_hw_load_control_plan.md) for
// the full handover picture.
bool ENABLE_LOAD_CONTROL = true;

//  NOTE:  if using PicoProbe to debug, uncomment #define PICO_PROBE to move Serial to Serial1
//#define PICO_PROBE

#ifdef ESP8266
#include <ESP8266WiFi.h>
#else
#include <WiFi.h>
#endif
#include <ESPAutoWiFiConfig.h>

#include <pfodDebugPtr.h>
#include <ESP_PicoW_pfodWebServer.h>
#include "pfodMainMenu.h"
#include "SolarForecastRefresh.h"
#include "SolarForecastFetch.h"
#include "GatewayRefresh.h"
#include "InternetPollTask.h"
#include "EnlightenHistoryRefresh.h"
#include "AvgConsumptionRefresh.h"
#include "BatteryProjection.h"
#include "ntpSupport.h"
#include "TimestampStream.h"
#include "ShadeFactorTable.h"
#include "MorningFloorTable.h"
#include "EnphaseAuth.h"
#include "SiteSettings.h"
#include "EnlightenLoginFetch.h"
#include "DailyReboot.h"
#include "webPages.h"
#include "BuzzerControl.h"
#include "BatteryChargeSettings.h"
#include "DebugLogBuffer.h"

// pfodMainMenuApp.cpp has no header of its own (see its own top comment) --
// declared extern here instead of adding one just for this single function.
extern void initDynamicMenuLabels();

//#define DEBUG

static Stream *debugPtr = NULL;
// Wraps an OPTIONAL real stream so every debugPtr->print()/println() call,
// in every file, gets a "[HH:MM:SS] " prefix -- see TimestampStream.h.
// Takes no Stream here (constructed before Serial.begin() has run) --
// setup() below calls timestampDebugStream.setDebugOut(&Serial) once
// Serial is actually ready.
static TimestampStream timestampDebugStream;

const char version[] = "V1";  // need non blank version for auto refresh

// if running under PicoProbe debugging move Serial to Serial1
#ifdef PICO_PROBE
#define Serial Serial1
#endif



// WiFi connect/AP-config is entirely handled by ESPAutoWiFiConfigSetup()/
// ESPAutoWiFiConfigLoop() (called from setup()/loop() below) -- no
// setupWiFi() of our own any more. NOTE the library's own static-IP path
// sets DNS explicitly to Google's public DNS (8.8.8.8/8.8.8.4), so hostname
// lookups (Open-Meteo, Enlighten) still work once a static IP is
// configured -- this sketch used to need its own explicit DNS fix for
// exactly that failure mode; the library doesn't have that bug. See
// ESPAutoWiFiConfigAI-guide.md 6 for the one real caveat (the gateway is
// always assumed to be the static IP's own subnet with .1 as the last
// octet).


void setup(void) {
#ifdef DEBUG
  Serial.begin(115200);
  for (int i = 10; i > 0; i--) {
    Serial.print(i);
    Serial.print(' ');
    delay(1000);
  }
  Serial.println();
  // Serial is actually ready now -- safe to point TimestampStream at it.
  // Pass nullptr instead (or omit this line entirely) if Serial output
  // isn't wanted -- the Log Tail buffer/stream (DebugLogBuffer.h) keeps
  // working either way, see TimestampStream.h's own comment.
  timestampDebugStream.setDebugOut(&Serial);
  // Wired to Serial directly, NOT timestampDebugStream/DebugLogBuffer --
  // ESPAutoWiFiConfig's own debug output includes the saved WiFi password
  // in clear text (see ESPAutoWiFiConfigAI-guide.md 8), and
  // DebugLogBuffer.h's relay is readable over the network via the pfodWeb
  // "Log Tail" button. Routing it there would leak the password to anyone
  // with the app connected. Serial is a local, physical-console-only
  // channel, and only enabled at all under this file's own #define DEBUG.
  setESPAutoWiFiConfigDebugOut(Serial);
#endif

  // Near the top of setup(), per ESPAutoWiFiConfigAI-guide.md -- if this
  // device has no stored WiFi network yet (or was double-power-cycled
  // within 10sec to force reconfiguration), it starts its own "WiFiConfig"
  // Access Point and serves a setup web page instead, so the rest of
  // setup() (LittleFS loads, web server, background polling) must not run
  // yet -- see the top-of-file comment for the end-user config flow.
  if (ESPAutoWiFiConfigSetup(wifiConfigLedPin, wifiConfigHighForLedOn, 0, wifiConfigDeviceName)) {
    return; // in WiFi AP config mode
  }

  setDebugPtr(&timestampDebugStream);      //set global debug
  debugPtr = getDebugPtr();  // enable extra debug here

  // Solar forecast shading-adjustment data (BatterySolarMonitorUpdate/
  // py_programs/solar_shading_model.py's shade_grid.csv/morning_floor.csv)
  // now loads from LittleFS -- see ShadeFactorTable.h/MorningFloorTable.h
  // -- not the SD card: CMD0 (the SD card's own reset command) never got a
  // response over SPI on this board's wiring (confirmed via Core Debug
  // Level=Error: "sdCommand(): Card Failed! cmd: 0x00"), so
  // SDCardSupport.h is kept around for whenever that hardware issue gets
  // revisited, but is no longer called here. All three CSVs are uploaded
  // the same way the pfodWeb UI files already are (this sketch's data/
  // subdirectory, via the LittleFS upload plugin -- see
  // useLittleFSToServe_pfodWeb above).
  loadShadeFactorTable();
  loadMorningFloorTable();
  // Enphase credentials (gateway JWT/IP, Enlighten session/system ID) --
  // see EnphaseAuth.h. WiFi is already connected by this point (the
  // ESPAutoWiFiConfigSetup() call above, near the top of setup()) --
  // needed before anything that could reach GatewayFetch.cpp/
  // EnlightenHistoryFetch.cpp, both of which read these accessors.
  loadEnphaseAuth();
  // Fixed per-site config (lat/long, panel tilt/azimuth, system kW,
  // timezone, car charger/hot water LAN IPs) -- see SiteSettings.h. Must
  // load before initializeNtpSupport() below (its loadTimeZoneConfig()
  // falls back to get_ntpSupport_DefaultTZ()'s override, which reads
  // sitePosixTimezone()) and before anything that could reach
  // SolarForecastFetch.cpp/SunPosition.cpp/CarChargerFetch.cpp/
  // HotWaterFetch.cpp.
  loadSiteConfig();
  // Rebuilds the main menu's '[EV Settings]'/'[Enphase Settings]' links
  // from the config just loaded above, instead of the pfodWeb Designer's
  // generated literal LAN IP/Enphase system ID -- see
  // pfodMainMenuApp.cpp's own initDynamicMenuLabels() comment. Must run
  // after both loadEnphaseAuth() and loadSiteConfig() above, and before
  // start_pfodWebServer() below (any real client's first sendMainMenu()).
  initDynamicMenuLabels();

    // NTP / timezone setup so the bottom-of-display time/date stays current.
  setNtpSupportDebug(NULL); // NTP debug off -- too noisy (every UDP request/response, full ShowTimeDebug block)
  // initializeNtpSupport() already loads the saved TZ from LittleFS itself
  // (loadTimeZoneConfig()) -- including falling back to and PERSISTING the
  // site default on a genuinely fresh device with no saved config yet, so
  // there is nothing left for a separate resetDefaultTZstr() call to do
  // here. A resetDefaultTZstr() call used to sit right here ("only need
  // this first time through") -- REMOVED 2026-09-17, per explicit bug
  // report: it force-overwrote+resaved the site default over the top of
  // whatever loadTimeZoneConfig() had just correctly loaded, on EVERY
  // boot, not just the first -- any TZ set via settz.html's "Set TZ
  // Format" was silently reverted back to the default the next time the
  // device rebooted. resetDefaultTZstr() itself is unchanged and still
  // correctly used by webPages.cpp's handle_resetTZ() (the settz.html
  // "Reset Default Time Zone" button) -- that's a deliberate,
  // user-triggered reset, not an every-boot one.
  initializeNtpSupport();

  initializeBuzzer();

  // Every generated dwg's own init() (Dwg_X.cpp, and pfodMainMenu::init())
  // primes its own pfodAutoIdx/pfodAutoCmd at its own end, by sending its
  // full drawing to a local discard-sink pfodParser -- so this one call
  // already forces every drawing's numbering to a fixed, deterministic
  // value before any real client can connect, with nothing extra needed
  // here.
  handle_mainMenuFnPtr mainMenuPtr = init_pfodMainMenu(); // initialize dwgs if any
  // rawDataBufferSize=16384 (was the library's own default 4096) -- big
  // enough to hold DebugLogBuffer.h's own "Log Tail" backlog directly (that
  // file used to keep a separate 16K buffer of its own specifically
  // because the library's relay was too small; not needed any more now
  // that the relay itself is sized to match -- see that file's own
  // comment).
  start_pfodWebServer(version, useLittleFSToServe_pfodWeb, cacheSec, mainMenuPtr, 16384);
  // Flushes DebugLogBuffer.cpp's own small pre-webserver-startup capture
  // buffer into the httpRawData relay just allocated above, so the config
  // loaders' own debug output earlier in setup() (loadEnphaseAuth()/
  // loadSiteConfig(), before this line -- getRawDataWriter()'s own
  // writeHttpRawData() silently drops anything written before
  // start_pfodWebServer() has run) shows up in Log Tail too, instead of
  // only ever reaching the physical Serial console -- added 2026-09-28,
  // per explicit instruction, after a real Log Tail capture confirmed
  // those messages were missing. Must be called here, right after
  // start_pfodWebServer() -- see DebugLogBuffer.h's own comment.
  notifyWebServerStarted();
  addSetTzWebPages();  // /settz.html + its /setTZstr, /resetTZ, /setTime handlers
  // <<<<<<<<< Your extra setup code goes here
  // Resolves api.open-meteo.com from the main task -- MUST happen before
  // startInternetPollTask() below, and must never be done from that
  // background task itself. See SolarForecastFetch.h for why (ESP-IDF
  // dns_clear_cache() is unsafe outside the lwIP-owning task; this was
  // the confirmed root cause of the earlier udp_remove crash).
  resolveSolarForecastHost();
  // Same again -- see EnlightenLoginFetch.h. Resolved once here (not on a
  // recurring timer) since DailyReboot.h's daily reboot already gives this
  // a fresh resolve once a day, comfortably inside the session cookie's
  // ~14-day freshness window.
  resolveEnlightenLoginHosts();
  // Arms EnlightenLoginFetch.cpp's/EnlightenHistoryRefresh.cpp's own
  // uptime-floor timers -- must run once, here in setup(), before loop()
  // ever calls checkEnlightenLoginPoll()/checkEnlightenHistory() for the
  // first time, so each timer is already running (not left unstarted)
  // from its very first check. initializeEnlightenLoginFetch() isn't
  // optional the way the other init...()s here might look -- see that
  // function's own comment: without it, checkEnlightenLoginPoll()'s
  // unconditional justFinished() check would otherwise be paired with an
  // isRunning()-gated re-arm that perpetually resets itself and never
  // reaches the login logic at all (confirmed as a real bug in practice).
  initializeEnlightenLoginFetch();
  initializeEnlightenHistoryRefresh();
  // Runs the Gateway/Solar (+weather)/Enlighten polls in turn on one
  // shared background task -- see InternetPollTask.cpp for why they're
  // consolidated instead of each having its own task.
  startInternetPollTask();

  // One-off heap headroom check, added 2026-09-20 when the Log Tail
  // buffer was bumped from 8K to 16K -- now start_pfodWebServer()'s own
  // rawDataBufferSize allocation (see the 16384 passed to it above), but
  // still the same idea: that (and every other permanent allocation made
  // above) is already accounted for by this point, so this is the free
  // heap this device actually runs with day to day, before any transient
  // HTTPS/JSON fetch adds its own temporary usage on top.
  if (debugPtr) {
    debugPtr->print(F("Free heap after setup(): "));
    debugPtr->println(ESP.getFreeHeap());
  }
}

void handle_parser() {
  handle_pfodWebServer();
}


void loop(void) {
  if (ESPAutoWiFiConfigLoop()) {  // handle WiFi config webpages
    return;  // still in AP config mode -- skip the rest of loop() until reconfigured + rebooted
  }
  processNTP(); // periodic NTP refresh; cheap when no update is due
  checkMains(); // buzz if no mains
  handle_parser();
  checkBatteryChargeSettingsSave(); // commit debounced HW/EV slider changes to LittleFS -- see BatteryChargeSettings.h
  // <<<<<<<<< Your extra loop code goes here
  checkSolarForecastRefresh();
  checkGatewayRefresh();
  checkEnlightenHistory();
  checkAvgConsumptionRefresh();
  checkBatteryProjection();
  checkDailyReboot();
}
