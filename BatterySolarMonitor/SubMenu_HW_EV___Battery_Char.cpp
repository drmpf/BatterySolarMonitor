// Board: FireBeetle 2 ESP32-E
// Connection: http

/* Code generated by pfodWeb V4.1.13-- 20th Sept 2026
 * (c)2026 Forward Computing and Control Pty. Ltd.
 * NSW Australia, www.forward.com.au
 * This code is not warranted to be fit for any purpose. You may only use it at your own risk.
 * This generated code may be freely used for both private and commercial use
 * provided this copyright is maintained.
 */
// SubMenu_HW_EV___Battery_Char.cpp -- generated by pfodWeb Generate Code
// Arduino code for sub-menu: HW/EV - Battery Charge% to start charging  and Max Temp for Hot

#include "SubMenu_HW_EV___Battery_Char.h"

static const unsigned long refresh_ms = 0;
const char* SubMenu_HW_EV___Battery_Char_promptText_var = "The turn off % is 5% below\nthe on/start setting\nTo disable set to max (right)\nTo force always set to min (left)\n"; // current prompt text -- change this + call sendMenu() or sendMenuUpdate() to update the prompt

const char* label_Set_Default_Car_var = "Set Default Car and HW start %"; // current text for 'Set Default Car and HW start %' -- change this + call sendMenu() to update the label (see docs/pfodAI-guide.md §6.3a to also push it via sendMenuUpdate())
int pwm_HW_On_at_var = 10; // 'HW On at'
int pwm_EV_Charging_at_var = 10; // 'EV Charging at'
const char* label__var = ""; // current text for 'label' -- change this + call sendMenu() to update the label (see docs/pfodAI-guide.md §6.3a to also push it via sendMenuUpdate())
const char* label_Set_Hot_Day_tri_var = "Set Hot Day trigger Temperature\nand Car / HW start charging %"; // current text for 'Set Hot Day trigger Temperature and Car / HW start charging %' -- change this + call sendMenu() to update the label (see docs/pfodAI-guide.md §6.3a to also push it via sendMenuUpdate())
int pwm_Tomorrows_Max_var = 20; // 'Tomorrows Max'
int pwm_Hot_Day_HW_star_var = 10; // 'Hot Day HW start'
int pwm_Hot_Day_Car_sta_var = 10; // 'Hot Day Car start'

SubMenu_HW_EV___Battery_Char subMenu_HW_EV___Battery_Char;
// weak: defining this function in any other .cpp replaces it, which is
// how a subclass takes over without editing this file -- see SubMenu_HW_EV___Battery_Char.h
SubMenu_HW_EV___Battery_Char& __attribute__((weak)) get_subMenu_HW_EV___Battery_Char() { return subMenu_HW_EV___Battery_Char; }

void SubMenu_HW_EV___Battery_Char::onHwOnAtChanged(int value) {
  (void)value;
}

void SubMenu_HW_EV___Battery_Char::onEvChargingAtChanged(int value) {
  (void)value;
}

void SubMenu_HW_EV___Battery_Char::onTomorrowsMaxChanged(int value) {
  (void)value;
}

void SubMenu_HW_EV___Battery_Char::onHotDayHwStartChanged(int value) {
  (void)value;
}

void SubMenu_HW_EV___Battery_Char::onHotDayCarStartChanged(int value) {
  (void)value;
}

SubMenu_HW_EV___Battery_Char::SubMenu_HW_EV___Battery_Char() {
  initialized = false;
}

void SubMenu_HW_EV___Battery_Char::init() {
  if (initialized) {
    return;
  }
  initialized = true;
  // Forces this sub-menu's pfodAutoCmds to fixed, deterministic values at
  // boot instead of leaving them lazily assigned by client request order --
  // sent to a local discard sink (default-constructed pfodParser leaves
  // io=NULL, so its write()s silently no-op), never a real client. Runs
  // BEFORE the drawings and nested sub-menus below, so this level takes
  // the lower cmds and everything it reaches takes higher ones.
  pfodParser primingSink;
  sendMenu(primingSink);  // before any included dwgs or submenus to match later gets higher idx

}

void SubMenu_HW_EV___Battery_Char::sendMenu(pfodParser& parser) {
  parser.menu();  // start a Menu screen pfod message.  Send {,
  parser.print(F("<bg bl>~")); // background dark blue
  parser.print(SubMenu_HW_EV___Battery_Char_promptText_var); // output the current prompt text
  parser.sendRefreshAndVersion(refresh_ms);
  parser.label(label_Set_Default_Car_Cmd); // start Label -- 'Set Default Car and HW start %'
  parser.print(F("<bg bl><b>")); // background dark blue, bold
  parser.print(F("~"));
  parser.print(label_Set_Default_Car_var); // output the current text
  parser.slider(pwm_HW_On_at_Cmd); // start Slider -- 'HW On at'
  parser.print(F("<bg bl>")); // background dark blue
  parser.print('`');
  parser.print(pwm_HW_On_at_var); // output the current value
  parser.print(F("~HW On at ~% House Battery Charge`100`10~100~10~"));
  parser.slider(pwm_EV_Charging_at_Cmd); // start Slider -- 'EV Charging at'
  parser.print(F("<bg bl>")); // background dark blue
  parser.print('`');
  parser.print(pwm_EV_Charging_at_var); // output the current value
  parser.print(F("~EV Charging at ~% Battery Charge`100`10~100~10~"));
  parser.label(label__Cmd); // start Label -- 'label'
  parser.print(F("<bg bl>")); // background dark blue
  parser.print(F("~"));
  parser.print(label__var); // output the current text
  parser.label(label_Set_Hot_Day_tri_Cmd); // start Label -- 'Set Hot Day trigger Temperature and Car / HW start charging %'
  parser.print(F("<bg bl><b>")); // background dark blue, bold
  parser.print(F("~"));
  parser.print(label_Set_Hot_Day_tri_var); // output the current text
  parser.slider(pwm_Tomorrows_Max_Cmd); // start Slider -- 'Tomorrows Max'
  parser.print(F("<bg bl>")); // background dark blue
  parser.print('`');
  parser.print(pwm_Tomorrows_Max_var); // output the current value
  parser.print(F("~Tomorrows Max ~℃`40`20~40~20~"));
  parser.slider(pwm_Hot_Day_HW_star_Cmd); // start Slider -- 'Hot Day HW start'
  parser.print(F("<bg bl>")); // background dark blue
  parser.print('`');
  parser.print(pwm_Hot_Day_HW_star_var); // output the current value
  parser.print(F("~Hot Day HW start ~%`100`10~100~10~"));
  parser.slider(pwm_Hot_Day_Car_sta_Cmd); // start Slider -- 'Hot Day Car start'
  parser.print(F("<bg bl>")); // background dark blue
  parser.print('`');
  parser.print(pwm_Hot_Day_Car_sta_var); // output the current value
  parser.print(F("~Hot Day Car start ~%`100`10~100~10~"));
  parser.endOfMsg();
}

void SubMenu_HW_EV___Battery_Char::sendMenuUpdate(pfodParser& parser) {
  parser.menuUpdate();  // start an Update Menu pfod message. Send {;
  // send menu items that should be updated
  parser.slider(pwm_HW_On_at_Cmd); // start Slider
  parser.print('`');
  parser.print(pwm_HW_On_at_var); // output the current value
  parser.slider(pwm_EV_Charging_at_Cmd); // start Slider
  parser.print('`');
  parser.print(pwm_EV_Charging_at_var); // output the current value
  parser.slider(pwm_Tomorrows_Max_Cmd); // start Slider
  parser.print('`');
  parser.print(pwm_Tomorrows_Max_var); // output the current value
  parser.slider(pwm_Hot_Day_HW_star_Cmd); // start Slider
  parser.print('`');
  parser.print(pwm_Hot_Day_HW_star_var); // output the current value
  parser.slider(pwm_Hot_Day_Car_sta_Cmd); // start Slider
  parser.print('`');
  parser.print(pwm_Hot_Day_Car_sta_var); // output the current value
  parser.endOfMsg();
}

bool SubMenu_HW_EV___Battery_Char::handleCmd(pfodParser &parser, uint8_t cmd, uint8_t *pfodFirstArg, long *pfodLongRtn) {
  (void)cmd;
  if (false) {
    // never taken -- keeps every real branch below in a uniform "} else if" shape
//  } else if(parser.cmdEquals(label_Set_Default_Car_Cmd)) { // pfodApp NEVER sends this cmd -- 'Set Default Car and HW start %'

  } else if(parser.cmdEquals(pwm_HW_On_at_Cmd)) { // user moved slider -- 'HW On at'
    parser.parseLong(pfodFirstArg,pfodLongRtn); // parse first arg as a long
    pwm_HW_On_at_var = (int)(*pfodLongRtn); // set variable
    onHwOnAtChanged(pwm_HW_On_at_var); // virtual hook -- hardware/action handling
    sendMenuUpdate(parser); // always send back a pfod msg otherwise pfodApp will disconnect.
    return true;
  } else if(parser.cmdEquals(pwm_EV_Charging_at_Cmd)) { // user moved slider -- 'EV Charging at'
    parser.parseLong(pfodFirstArg,pfodLongRtn); // parse first arg as a long
    pwm_EV_Charging_at_var = (int)(*pfodLongRtn); // set variable
    onEvChargingAtChanged(pwm_EV_Charging_at_var); // virtual hook -- hardware/action handling
    sendMenuUpdate(parser); // always send back a pfod msg otherwise pfodApp will disconnect.
    return true;
//  } else if(parser.cmdEquals(label__Cmd)) { // pfodApp NEVER sends this cmd -- 'label'

//  } else if(parser.cmdEquals(label_Set_Hot_Day_tri_Cmd)) { // pfodApp NEVER sends this cmd -- 'Set Hot Day trigger Temperature and Car / HW start charging %'

  } else if(parser.cmdEquals(pwm_Tomorrows_Max_Cmd)) { // user moved slider -- 'Tomorrows Max'
    parser.parseLong(pfodFirstArg,pfodLongRtn); // parse first arg as a long
    pwm_Tomorrows_Max_var = (int)(*pfodLongRtn); // set variable
    onTomorrowsMaxChanged(pwm_Tomorrows_Max_var); // virtual hook -- hardware/action handling
    sendMenuUpdate(parser); // always send back a pfod msg otherwise pfodApp will disconnect.
    return true;
  } else if(parser.cmdEquals(pwm_Hot_Day_HW_star_Cmd)) { // user moved slider -- 'Hot Day HW start'
    parser.parseLong(pfodFirstArg,pfodLongRtn); // parse first arg as a long
    pwm_Hot_Day_HW_star_var = (int)(*pfodLongRtn); // set variable
    onHotDayHwStartChanged(pwm_Hot_Day_HW_star_var); // virtual hook -- hardware/action handling
    sendMenuUpdate(parser); // always send back a pfod msg otherwise pfodApp will disconnect.
    return true;
  } else if(parser.cmdEquals(pwm_Hot_Day_Car_sta_Cmd)) { // user moved slider -- 'Hot Day Car start'
    parser.parseLong(pfodFirstArg,pfodLongRtn); // parse first arg as a long
    pwm_Hot_Day_Car_sta_var = (int)(*pfodLongRtn); // set variable
    onHotDayCarStartChanged(pwm_Hot_Day_Car_sta_var); // virtual hook -- hardware/action handling
    sendMenuUpdate(parser); // always send back a pfod msg otherwise pfodApp will disconnect.
    return true;
  }
  return false;
}

