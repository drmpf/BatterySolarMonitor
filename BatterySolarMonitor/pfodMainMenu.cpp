// Board: FireBeetle 2 ESP32-E
// Connection: http

/* Code generated by pfodWeb V4.1.13-- 20th Sept 2026
 * (c)2026 Forward Computing and Control Pty. Ltd.
 * NSW Australia, www.forward.com.au
 * This code is not warranted to be fit for any purpose. You may only use it at your own risk.
 * This generated code may be freely used for both private and commercial use
 * provided this copyright is maintained.
 */
/* ===== pfod Command for BatterySolarMonitor ====
pfodApp msg {.} --> {,<bg w>~`0~V1|c0<bg w>~Home|c1<bg w>~TodaySolar|c2<bg w>~Tomorrow|!c3<bg w>~<+7><b>[EV Settings](http://10.1.1.xxx/index.html)|c4<bg w>~HW/EV - Battery Charge%
to start charging
 and Max Temp for Hot |!c5<bg w>~Battery will discharge to grid..
Battery will charge from grid..|c6<bg w>~<g><b>Auto Battery Charge/Discharge Enabled</g>
Click here to Di|!c7<bg w>~<+7><b>[Enphase Settings](https://enlighten.enphaseenergy.com/web/_siteNo_)|!c8<bg w>~<b>[Set Time/Timezone](/settz.html)|c9<bg w>~Log Tail|c10<bg w>~<b><r>Clear Recovery Flag</b>
Auto V2H recovery in Auto on times}
 */
// pfodMainMenu.cpp

#include "pfodMainMenu.h"
#include <pfodParser.h>
#include <pfodDebugPtr.h>
#include "Dwg_Home.h"
#include "Dwg_TodaySolar.h"
#include "Dwg_TomorrowChart.h"
#include "SubMenu_HW_EV___Battery_Char.h" // sub-menu -- 'HW/EV - Battery Charge% to start charging  and Max Temp for Hot'

// #define DEBUG

pfodMainMenu mainMenu;
// weak: defining this function in any other .cpp replaces it, which is
// how a subclass takes over without editing this file -- see pfodMainMenu.h
pfodMainMenu& __attribute__((weak)) get_pfodMainMenu() { return mainMenu; }

static Print* debugPtr = NULL;  // local to this file
static const unsigned long refresh_ms = 30000; // main menu refresh
const char* mainMenuPromptText_var = ""; // current prompt text -- change this + call sendMainMenu() or sendMainMenuUpdate() to update the prompt

const char* label_EV_Settings_htt_var = "[EV Settings](http://10.1.1.xxx/index.html)"; // current text for '[EV Settings](http://10.1.1.xxx/index.html)' -- change this + call sendMainMenu() to update the label (see docs/pfodAI-guide.md §6.3a to also push it via sendMainMenuUpdate())
const char* submenu_HW_EV_Battery_C_var = "HW/EV - Battery Charge%\nto start charging\n and Max Temp for Hot "; // current text for 'HW/EV - Battery Charge% to start charging  and Max Temp for Hot' -- change this + call sendMainMenu() to update the sub-menu button
const char* label_Battery_will_di_var = "Battery will discharge to grid..\nBattery will charge from grid.."; // current text for 'Battery will discharge to grid.. Battery will charge from grid..' -- change this + call sendMainMenu() to update the label (see docs/pfodAI-guide.md §6.3a to also push it via sendMainMenuUpdate())
const char* button_Auto_Battery_Ch_var = "<g><b>Auto Battery Charge/Discharge Enabled</g>\nClick here to Di"; // current text for '<g><b>Auto Battery Charge/Discharge Enabled</g> Click here to Di' -- change this + call sendMainMenu() to update the button
const char* label_Enphase_Setting_var = "[Enphase Settings](https://enlighten.enphaseenergy.com/web/_siteNo_)"; // current text for '[Enphase Settings](https://enlighten.enphaseenergy.com/web/_siteNo_)' -- change this + call sendMainMenu() to update the label (see docs/pfodAI-guide.md §6.3a to also push it via sendMainMenuUpdate())
const char* label_Set_Time_Timezo_var = "[Set Time/Timezone](/settz.html)"; // current text for '[Set Time/Timezone](/settz.html)' -- change this + call sendMainMenu() to update the label (see docs/pfodAI-guide.md §6.3a to also push it via sendMainMenuUpdate())
const char* button_Log_Tail_var = "Log Tail"; // current text for 'Log Tail' -- change this + call sendMainMenu() to update the button
const char* button_Clear_Recovery_var = "<b><r>Clear Recovery Flag</b>\nAuto V2H recovery in Auto on times"; // current text for '<b><r>Clear Recovery Flag</b> Auto V2H recovery in Auto on times' -- change this + call sendMainMenu() to update the button

unsigned long plot_msOffset = 0; // set by {@} response
bool clearPlot = false; // set by the {@} response code

void pfodMainMenu::onAutoBatteryChargeDisPressed(pfodParser &parser) {
  // << add your action code here for this button
  parser.print(F("{}")); // change this return as needed.
}

void pfodMainMenu::onLogTailPressed(pfodParser &parser) {
  // << add your action code here for this button
  parser.print(F("{}")); // change this return as needed.
}

void pfodMainMenu::onClearRecoveryFlagAutPressed(pfodParser &parser) {
  // << add your action code here for this button
  parser.print(F("{}")); // change this return as needed.
}

pfodMainMenu::pfodMainMenu() {
  initialized = false;
  closeConnectionFnPtr = NULL;
}

void pfodMainMenu::init(pfodCloseConnectionPtr _closeConnectionFnPtr) {
  if (initialized) {
    return;
  }
  (void)debugPtr;  // suppress not used warning
#ifdef DEBUG
  debugPtr = getDebugPtr();
#endif
  initialized = true;
  closeConnectionFnPtr = _closeConnectionFnPtr;
  // Forces this menu's pfodAutoCmds to fixed, deterministic values at boot
  // instead of leaving them lazily assigned by client request order -- sent
  // to a local discard sink (default-constructed pfodParser leaves io=NULL,
  // so its write()s silently no-op), never a real client. Runs BEFORE the
  // drawings and sub-menus below, so this menu takes the lower cmds and
  // everything it reaches takes higher ones.
  pfodParser primingSink;
  sendMainMenu(primingSink);  // before any included dwgs or submenus to match later gets higher idx

  get_dwg_Home().init(); // initialize drawing -- 'Home'
  get_dwg_TodaySolar().init(); // initialize drawing -- 'TodaySolar'
  get_dwg_TomorrowChart().init(); // initialize drawing -- 'Tomorrow'
  get_subMenu_HW_EV___Battery_Char().init(); // initialize sub-menu
}

// the loop routine runs over and over again forever:
void pfodMainMenu::handle(pfodParser& parser) {
  if (!initialized) {
    if (debugPtr) {
      debugPtr->println(F(" Need to call init_pfodMainMenu() from setup()."));
    }
  }
  uint8_t cmd = parser.parse(); // parse incoming data from connection
  // parser returns non-zero when a pfod command is fully parsed
  if (cmd != 0) { // have parsed a complete msg { to }
    uint8_t* pfodFirstArg = parser.getFirstArg(); // may point to \0 if no arguments in this msg.
    pfod_MAYBE_UNUSED(pfodFirstArg); // may not be used, just suppress warning
    long pfodLongRtn; // used for parsing long return arguments, if any
    pfod_MAYBE_UNUSED(pfodLongRtn); // may not be used, just suppress warning
    if ('.' == cmd) {
      // pfodApp has connected and sent {.} , it is asking for the main menu
      if (!parser.isRefresh()) {
        sendMainMenu(parser); // send back the menu designed
      } else {
        sendMainMenuUpdate(parser); // menu is cached just send update
      }

      // handle {@} request
    } else if('@'==cmd) { // pfodApp requested 'current' time
      plot_msOffset = millis(); // capture current millis as offset rawdata timestamps
      clearPlot = true; // clear plot on reconnect as have new plot_msOffset
      parser.print(F("{@`0}")); // return `0 as 'current' raw data milliseconds
    

    // now handle commands returned from button/sliders
    } else if(parser.cmdEquals(dwgMenuItem_Home_Cmd)) { // user touch not handled by dwg, handle it here
      // drawing loadCmd handled internally by get_dwg_xxx().init()
      // add touchZone handling here and return response for inputs that return false from processDwgCmds()
      sendMainMenuUpdate(parser); // always send back a pfod msg otherwise pfodApp will disconnect.

    } else if(parser.cmdEquals(dwgMenuItem_TodaySolar_Cmd)) { // user touch not handled by dwg, handle it here
      // drawing loadCmd handled internally by get_dwg_xxx().init()
      // add touchZone handling here and return response for inputs that return false from processDwgCmds()
      sendMainMenuUpdate(parser); // always send back a pfod msg otherwise pfodApp will disconnect.

    } else if(parser.cmdEquals(dwgMenuItem_Tomorrow_Cmd)) { // user touch not handled by dwg, handle it here
      // drawing loadCmd handled internally by get_dwg_xxx().init()
      // add touchZone handling here and return response for inputs that return false from processDwgCmds()
      sendMainMenuUpdate(parser); // always send back a pfod msg otherwise pfodApp will disconnect.

//    } else if(parser.cmdEquals(label_EV_Settings_htt_Cmd)) { // pfodApp NEVER sends this cmd -- '[EV Settings](http://10.1.1.xxx/index.html)'

    } else if(parser.cmdEquals(submenu_HW_EV_Battery_C_Cmd)) { // user pressed sub-menu button -- 'HW/EV - Battery Charge% to start charging  and Max Temp for Hot'
      if (!parser.isRefresh()) {
        get_subMenu_HW_EV___Battery_Char().sendMenu(parser); // send the sub-menu
      } else {
        get_subMenu_HW_EV___Battery_Char().sendMenuUpdate(parser); // refresh the sub-menu
      }

//    } else if(parser.cmdEquals(label_Battery_will_di_Cmd)) { // pfodApp NEVER sends this cmd -- 'Battery will discharge to grid.. Battery will charge from grid..'

    } else if(parser.cmdEquals(button_Auto_Battery_Ch_Cmd)) { // user pressed -- '<g><b>Auto Battery Charge/Discharge Enabled</g> Click here to Di'
      onAutoBatteryChargeDisPressed(parser); // virtual hook -- must send a pfod response

//    } else if(parser.cmdEquals(label_Enphase_Setting_Cmd)) { // pfodApp NEVER sends this cmd -- '[Enphase Settings](https://enlighten.enphaseenergy.com/web/_siteNo_)'

//    } else if(parser.cmdEquals(label_Set_Time_Timezo_Cmd)) { // pfodApp NEVER sends this cmd -- '[Set Time/Timezone](/settz.html)'

    } else if(parser.cmdEquals(button_Log_Tail_Cmd)) { // user pressed -- 'Log Tail'
      onLogTailPressed(parser); // virtual hook -- must send a pfod response

    } else if(parser.cmdEquals(button_Clear_Recovery_Cmd)) { // user pressed -- '<b><r>Clear Recovery Flag</b> Auto V2H recovery in Auto on times'
      onClearRecoveryFlagAutPressed(parser); // virtual hook -- must send a pfod response

    } else if (get_subMenu_HW_EV___Battery_Char().handleCmd(parser, cmd, pfodFirstArg, &pfodLongRtn)) {
      // handled by the sub-menu's own items
    } else if ('!' == cmd) {
      // CloseConnection command
      if (closeConnectionFnPtr) {
        closeConnectionFnPtr(parser.getPfodAppStream());
      }
    } else {
      // unknown command
      parser.print(F("{}")); // always send back a pfod msg otherwise pfodApp will disconnect.
    }
  }
  //  <<<<<<<<<<<  Your other loop() code goes here 
  
}

void pfodMainMenu::sendMainMenu(pfodParser& parser) {
  // !! Remember to change the parser version string OR Clear the cache
  //    every time you edit this method
  parser.menu();  // start a Menu screen pfod message.  Send {,
  // send menu background, format, prompt, refresh and version
  parser.print(F("<bg w>~")); // background white
  parser.print(mainMenuPromptText_var); // output the current prompt text
  parser.sendRefreshAndVersion(refresh_ms); // send the menu version 
  // send menu items
  parser.print(F("|+")); // start Drawing
  parser.print(dwgMenuItem_Home_Cmd); // drawing menu item cmd
  parser.print(F("<bg w>")); // background white
  parser.print(F("~"));
  parser.print(get_dwg_Home()); // the drawing's loadCmd
  parser.print(F("|+")); // start Drawing
  parser.print(dwgMenuItem_TodaySolar_Cmd); // drawing menu item cmd
  parser.print(F("<bg w>")); // background white
  parser.print(F("~"));
  parser.print(get_dwg_TodaySolar()); // the drawing's loadCmd
  parser.print(F("|+")); // start Drawing
  parser.print(dwgMenuItem_Tomorrow_Cmd); // drawing menu item cmd
  parser.print(F("<bg w>")); // background white
  parser.print(F("~"));
  parser.print(get_dwg_TomorrowChart()); // the drawing's loadCmd
  parser.label(label_EV_Settings_htt_Cmd); // start Label
  parser.print(F("<bg w><+7><b>")); // background white, +7 size, bold
  parser.print(F("~"));
  parser.print(label_EV_Settings_htt_var); // output the current text
  parser.button(submenu_HW_EV_Battery_C_Cmd); // start Button (opens sub-menu)
  parser.print(F("<bg w>")); // background white
  parser.print(F("~"));
  parser.print(submenu_HW_EV_Battery_C_var); // output the current text
  parser.label(label_Battery_will_di_Cmd); // start Label
  parser.print(F("<bg w>")); // background white
  parser.print(F("~"));
  parser.print(label_Battery_will_di_var); // output the current text
  parser.button(button_Auto_Battery_Ch_Cmd); // start Button
  parser.print(F("<bg w>")); // background white
  parser.print(F("~"));
  parser.print(button_Auto_Battery_Ch_var); // output the current text
  parser.label(label_Enphase_Setting_Cmd); // start Label
  parser.print(F("<bg w><+7><b>")); // background white, +7 size, bold
  parser.print(F("~"));
  parser.print(label_Enphase_Setting_var); // output the current text
  parser.label(label_Set_Time_Timezo_Cmd); // start Label
  parser.print(F("<bg w><b>")); // background white, bold
  parser.print(F("~"));
  parser.print(label_Set_Time_Timezo_var); // output the current text
  parser.button(button_Log_Tail_Cmd); // start Button
  parser.print(F("<bg w>")); // background white
  parser.print(F("~"));
  parser.print(button_Log_Tail_var); // output the current text
  parser.button(button_Clear_Recovery_Cmd); // start Button
  parser.print(F("<bg w>")); // background white
  parser.print(F("~"));
  parser.print(button_Clear_Recovery_var); // output the current text
  parser.endOfMsg();  // close pfod message. Send }
}

void pfodMainMenu::sendMainMenuUpdate(pfodParser& parser) {
  parser.menuUpdate();  // start an Update Menu pfod message. Send {;
  // send menu items that should be updated
  parser.print(F("|+")); // drawing menu item update
  parser.print(dwgMenuItem_Home_Cmd);
  parser.print(F("|+")); // drawing menu item update
  parser.print(dwgMenuItem_TodaySolar_Cmd);
  parser.print(F("|+")); // drawing menu item update
  parser.print(dwgMenuItem_Tomorrow_Cmd);
  parser.endOfMsg();  // close pfod message. Send }
  // ============ end of menu ===========
}

handle_mainMenuFnPtr init_pfodMainMenu(pfodCloseConnectionPtr _closeConnectionFnPtr) {
  get_pfodMainMenu().init(_closeConnectionFnPtr);
  return handle_pfodMainMenu;
}

void handle_pfodMainMenu(pfodParser& parser) {
  get_pfodMainMenu().handle(parser);
}
// ============= end generated code =========

